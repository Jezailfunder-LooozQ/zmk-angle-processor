## Kconfig
```kconfig
config ZMK_INPUT_PROCESSOR_ANGLE
    bool "Enable trackball angle correction processor"
    depends on INPUT
    default n
    help
      Enable a custom ZMK input processor that compensates
      for small trackball sensor mounting angle errors.
      The processor will use fixed-point calculations
      and preserve fractional movement between reports.
```

## dts/bindings/zmk,angle-input.yaml
```yaml
# SPDX-License-Identifier: MIT

description: >
  Virtual input device that receives XY movement from
  a physical trackball sensor and applies angle
  correction before forwarding the movement to ZMK.

compatible: "zmk,angle-input"

properties:
  source:
    type: phandle
    required: true
    description: Physical trackball input device

  angle-deg:
    type: int
    default: 10
    description: >
      Clockwise correction angle in screen coordinates,
      measured in degrees.
```

## dts/bindings/zmk,input-processor-angle.yaml
```yaml
# SPDX-License-Identifier: MIT

description: >
  ZMK input processor for correcting trackball sensor
  mounting angle using fixed-point coordinate rotation.

compatible: "zmk,input-processor-angle"

include: ip_one_param.yaml

properties: {}
```
